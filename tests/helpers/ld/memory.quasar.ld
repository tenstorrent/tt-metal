/*
 * SPDX-FileCopyrightText: (c) 2025 Tenstorrent AI ULC
 *
 * SPDX-License-Identifier: Apache-2.0
 */

LOCAL_MEM_BASE = 0x802000;
LOCAL_MEM_OFFSET = 0x2000;
TRISC0_LOCAL_MEM_LENGTH = 4K;
TRISC1_LOCAL_MEM_LENGTH = 2K;
TRISC2_LOCAL_MEM_LENGTH = 2K;
TRISC3_LOCAL_MEM_LENGTH = 4K;

L1_BASE = 0x0;
UNDEFINED = 0;

/* The address space layout goes as follows:
 * [TRISCs] (...) [LOCAL_MEM]
 * LOADER_INIT regions are defined for every core, as the data segment resides in LOCAL_MEM.
 * LOADER_CODE regions are undefined for all cores.
 * GCOV region is left undefined for obvious reasons.
 * BRISC and NCRISC dont exist on Quasar so all their regions are undefined.
 */
MEMORY
{
    /* Private memory layout for each core */
    TRISC0_LOCAL_DATA_MEM   : ORIGIN = LOCAL_MEM_BASE + 0 * LOCAL_MEM_OFFSET, LENGTH = 3K
    TRISC0_STACK_MEM        : ORIGIN = ORIGIN(TRISC0_LOCAL_DATA_MEM) + LENGTH(TRISC0_LOCAL_DATA_MEM), LENGTH = TRISC0_LOCAL_MEM_LENGTH - LENGTH(TRISC0_LOCAL_DATA_MEM)

    TRISC1_LOCAL_DATA_MEM   : ORIGIN = LOCAL_MEM_BASE + 1 * LOCAL_MEM_OFFSET, LENGTH = 1792
    TRISC1_STACK_MEM        : ORIGIN = ORIGIN(TRISC1_LOCAL_DATA_MEM) + LENGTH(TRISC1_LOCAL_DATA_MEM), LENGTH = TRISC1_LOCAL_MEM_LENGTH - LENGTH(TRISC1_LOCAL_DATA_MEM)

    TRISC2_LOCAL_DATA_MEM   : ORIGIN = LOCAL_MEM_BASE + 2 * LOCAL_MEM_OFFSET, LENGTH = 1792
    TRISC2_STACK_MEM        : ORIGIN = ORIGIN(TRISC2_LOCAL_DATA_MEM) + LENGTH(TRISC2_LOCAL_DATA_MEM), LENGTH = TRISC2_LOCAL_MEM_LENGTH - LENGTH(TRISC2_LOCAL_DATA_MEM)

    TRISC3_LOCAL_DATA_MEM   : ORIGIN = LOCAL_MEM_BASE + 3 * LOCAL_MEM_OFFSET, LENGTH = 3K
    TRISC3_STACK_MEM        : ORIGIN = ORIGIN(TRISC3_LOCAL_DATA_MEM) + LENGTH(TRISC3_LOCAL_DATA_MEM), LENGTH = TRISC3_LOCAL_MEM_LENGTH - LENGTH(TRISC3_LOCAL_DATA_MEM)


    /* L1 layout */
    TRISC0_CODE             : ORIGIN = L1_BASE, LENGTH = 16K
    TRISC0_LOADER_INIT_MEM  : ORIGIN = ORIGIN(TRISC0_CODE) + LENGTH(TRISC0_CODE), LENGTH = TRISC0_LOCAL_MEM_LENGTH

    TRISC1_CODE             : ORIGIN = ORIGIN(TRISC0_LOADER_INIT_MEM) + LENGTH(TRISC0_LOADER_INIT_MEM), LENGTH = 16K
    TRISC1_LOADER_INIT_MEM  : ORIGIN = ORIGIN(TRISC1_CODE) + LENGTH(TRISC1_CODE), LENGTH = TRISC1_LOCAL_MEM_LENGTH

    TRISC2_CODE             : ORIGIN = ORIGIN(TRISC1_LOADER_INIT_MEM) + LENGTH(TRISC1_LOADER_INIT_MEM), LENGTH = 16K
    TRISC2_LOADER_INIT_MEM  : ORIGIN = ORIGIN(TRISC2_CODE) + LENGTH(TRISC2_CODE), LENGTH = TRISC2_LOCAL_MEM_LENGTH

    TRISC3_CODE             : ORIGIN = ORIGIN(TRISC2_LOADER_INIT_MEM) + LENGTH(TRISC2_LOADER_INIT_MEM), LENGTH = 16K
    TRISC3_LOADER_INIT_MEM  : ORIGIN = ORIGIN(TRISC3_CODE) + LENGTH(TRISC3_CODE), LENGTH = TRISC3_LOCAL_MEM_LENGTH


    /* (discarded) */
    BRISC_CODE              : ORIGIN = UNDEFINED, LENGTH = UNDEFINED
    BRISC_LOADER_INIT_MEM   : ORIGIN = UNDEFINED, LENGTH = UNDEFINED
    BRISC_LOCAL_DATA_MEM    : ORIGIN = UNDEFINED, LENGTH = UNDEFINED
    BRISC_STACK_MEM         : ORIGIN = UNDEFINED, LENGTH = UNDEFINED
    BRISC_LOADER_CODE_MEM   : ORIGIN = UNDEFINED, LENGTH = UNDEFINED
    BRISC_GCOV_MEM          : ORIGIN = UNDEFINED, LENGTH = UNDEFINED

    TRISC0_LOADER_CODE_MEM  : ORIGIN = UNDEFINED, LENGTH = UNDEFINED
    TRISC0_GCOV_MEM         : ORIGIN = UNDEFINED, LENGTH = UNDEFINED

    TRISC1_LOADER_CODE_MEM  : ORIGIN = UNDEFINED, LENGTH = UNDEFINED
    TRISC1_GCOV_MEM         : ORIGIN = UNDEFINED, LENGTH = UNDEFINED

    TRISC2_LOADER_CODE_MEM  : ORIGIN = UNDEFINED, LENGTH = UNDEFINED
    TRISC2_GCOV_MEM         : ORIGIN = UNDEFINED, LENGTH = UNDEFINED

    TRISC3_LOADER_CODE_MEM  : ORIGIN = UNDEFINED, LENGTH = UNDEFINED
    TRISC3_GCOV_MEM         : ORIGIN = UNDEFINED, LENGTH = UNDEFINED

    NCRISC_CODE             : ORIGIN = UNDEFINED, LENGTH = UNDEFINED
    NCRISC_LOADER_INIT_MEM  : ORIGIN = UNDEFINED, LENGTH = UNDEFINED
    NCRISC_LOCAL_DATA_MEM   : ORIGIN = UNDEFINED, LENGTH = UNDEFINED
    NCRISC_STACK_MEM        : ORIGIN = UNDEFINED, LENGTH = UNDEFINED
    NCRISC_LOADER_CODE_MEM  : ORIGIN = UNDEFINED, LENGTH = UNDEFINED
    NCRISC_GCOV_MEM         : ORIGIN = UNDEFINED, LENGTH = UNDEFINED
}
PROVIDE(__instrn_buffer = 0x0080E000);
