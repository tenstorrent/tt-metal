/*
 * SPDX-FileCopyrightText: (c) 2025 Tenstorrent AI ULC
 *
 * SPDX-License-Identifier: Apache-2.0
 */

LOCAL_MEM_BASE = 0xFFB00000;
BRISC_LOCAL_MEM_LENGTH = 4K;
TRISC_LOCAL_MEM_LENGTH = 2K;
NCRISC_LOCAL_MEM_LENGTH = 4K;

NCRISC_IMEM = 0xFFC00000;
NCRISC_IMEM_LENGTH = 16K;

L1_BASE = 0x0;
UNDEFINED = 0;

/* The address space layout goes as follows:
 * [BRISC] [TRISCs] [NCRISC] (...) [LOCAL_MEM]
 * LOADER_INIT regions are defined for every core, as the data segment resides in LOCAL_MEM.
 * LOADER_CODE regions are undefined for all cores excepting the NCRISC, as its code resides in its IMEM.
 * GCOV region is left undefined for obvious reasons.
 */

MEMORY
{
    /* Private memory layout for each core */
    BRISC_LOCAL_DATA_MEM    : ORIGIN = LOCAL_MEM_BASE, LENGTH = 3K
    BRISC_STACK_MEM         : ORIGIN = ORIGIN(BRISC_LOCAL_DATA_MEM) + LENGTH(BRISC_LOCAL_DATA_MEM), LENGTH = BRISC_LOCAL_MEM_LENGTH - LENGTH(BRISC_LOCAL_DATA_MEM)

    TRISC0_LOCAL_DATA_MEM   : ORIGIN = LOCAL_MEM_BASE, LENGTH = 1792
    TRISC0_STACK_MEM        : ORIGIN = ORIGIN(TRISC0_LOCAL_DATA_MEM) + LENGTH(TRISC0_LOCAL_DATA_MEM), LENGTH = TRISC_LOCAL_MEM_LENGTH - LENGTH(TRISC0_LOCAL_DATA_MEM)

    TRISC1_LOCAL_DATA_MEM   : ORIGIN = LOCAL_MEM_BASE, LENGTH = 1792
    TRISC1_STACK_MEM        : ORIGIN = ORIGIN(TRISC1_LOCAL_DATA_MEM) + LENGTH(TRISC1_LOCAL_DATA_MEM), LENGTH = TRISC_LOCAL_MEM_LENGTH - LENGTH(TRISC1_LOCAL_DATA_MEM)

    TRISC2_LOCAL_DATA_MEM   : ORIGIN = LOCAL_MEM_BASE, LENGTH = 1792
    TRISC2_STACK_MEM        : ORIGIN = ORIGIN(TRISC2_LOCAL_DATA_MEM) + LENGTH(TRISC2_LOCAL_DATA_MEM), LENGTH = TRISC_LOCAL_MEM_LENGTH - LENGTH(TRISC2_LOCAL_DATA_MEM)

    NCRISC_LOCAL_DATA_MEM   : ORIGIN = LOCAL_MEM_BASE, LENGTH = 3K
    NCRISC_STACK_MEM        : ORIGIN = ORIGIN(NCRISC_LOCAL_DATA_MEM) + LENGTH(NCRISC_LOCAL_DATA_MEM), LENGTH = NCRISC_LOCAL_MEM_LENGTH - LENGTH(NCRISC_LOCAL_DATA_MEM)
    NCRISC_CODE             : ORIGIN = NCRISC_IMEM, LENGTH = NCRISC_IMEM_LENGTH


    /* L1 layout */
    BRISC_CODE              : ORIGIN = L1_BASE, LENGTH = 16K
    BRISC_LOADER_INIT_MEM   : ORIGIN = ORIGIN(BRISC_CODE) + LENGTH(BRISC_CODE), LENGTH = BRISC_LOCAL_MEM_LENGTH

    TRISC0_CODE             : ORIGIN = ORIGIN(BRISC_LOADER_INIT_MEM) + LENGTH(BRISC_LOADER_INIT_MEM), LENGTH = 16K
    TRISC0_LOADER_INIT_MEM  : ORIGIN = ORIGIN(TRISC0_CODE) + LENGTH(TRISC0_CODE), LENGTH = TRISC_LOCAL_MEM_LENGTH

    TRISC1_CODE             : ORIGIN = ORIGIN(TRISC0_LOADER_INIT_MEM) + LENGTH(TRISC0_LOADER_INIT_MEM), LENGTH = 16K
    TRISC1_LOADER_INIT_MEM  : ORIGIN = ORIGIN(TRISC1_CODE) + LENGTH(TRISC1_CODE), LENGTH = TRISC_LOCAL_MEM_LENGTH

    TRISC2_CODE             : ORIGIN = ORIGIN(TRISC1_LOADER_INIT_MEM) + LENGTH(TRISC1_LOADER_INIT_MEM), LENGTH = 16K
    TRISC2_LOADER_INIT_MEM  : ORIGIN = ORIGIN(TRISC2_CODE) + LENGTH(TRISC2_CODE), LENGTH = TRISC_LOCAL_MEM_LENGTH

    NCRISC_LOADER_INIT_MEM  : ORIGIN = ORIGIN(TRISC2_LOADER_INIT_MEM) + LENGTH(TRISC2_LOADER_INIT_MEM), LENGTH = NCRISC_LOCAL_MEM_LENGTH
    NCRISC_LOADER_CODE_MEM  : ORIGIN = ORIGIN(NCRISC_LOADER_INIT_MEM) + LENGTH(NCRISC_LOADER_INIT_MEM), LENGTH = LENGTH(NCRISC_CODE)


    /* (discarded) */
    BRISC_LOADER_CODE_MEM   : ORIGIN = UNDEFINED, LENGTH = UNDEFINED
    BRISC_GCOV_MEM          : ORIGIN = UNDEFINED, LENGTH = UNDEFINED

    TRISC0_LOADER_CODE_MEM  : ORIGIN = UNDEFINED, LENGTH = UNDEFINED
    TRISC0_GCOV_MEM         : ORIGIN = UNDEFINED, LENGTH = UNDEFINED

    TRISC1_LOADER_CODE_MEM  : ORIGIN = UNDEFINED, LENGTH = UNDEFINED
    TRISC1_GCOV_MEM         : ORIGIN = UNDEFINED, LENGTH = UNDEFINED

    TRISC2_LOADER_CODE_MEM  : ORIGIN = UNDEFINED, LENGTH = UNDEFINED
    TRISC2_GCOV_MEM         : ORIGIN = UNDEFINED, LENGTH = UNDEFINED

    NCRISC_GCOV_MEM         : ORIGIN = UNDEFINED, LENGTH = UNDEFINED
}
PROVIDE(__instrn_buffer = 0xFFE40000);
