/*
 * SPDX-FileCopyrightText: (c) 2024 Tenstorrent AI ULC
 *
 * SPDX-License-Identifier: Apache-2.0
 */

L0_BASE = 0xFFB00000;
BRISC_L0_LENGTH = 8K;
TRISC_L0_LENGTH = 4K;
NCRISC_L0_LENGTH = 8K;

L1_BASE = 0x0;
RUNTIME_ARGS_START = 0x64000;
UNDEFINED = 0;

/* The address space layout goes as follows:
 * [BRISC] [TRISCs] [NCRISC] (...) [L0]
 * LOADER_INIT regions are undefined, all data is in L1; only stack is in L0.
 * LOADER_CODE regions are undefined, as there is no NCRISC IMEM on Blackhole.
 * LOCAL_DATA and CODE regions are spacious because of instrumentation and less optimized kernels.
 */

MEMORY
{
    /* Private memory layout for each core */
    BRISC_STACK_MEM         : ORIGIN = L0_BASE, LENGTH = BRISC_L0_LENGTH
    TRISC0_STACK_MEM        : ORIGIN = L0_BASE, LENGTH = TRISC_L0_LENGTH
    TRISC1_STACK_MEM        : ORIGIN = L0_BASE, LENGTH = TRISC_L0_LENGTH
    TRISC2_STACK_MEM        : ORIGIN = L0_BASE, LENGTH = TRISC_L0_LENGTH
    NCRISC_STACK_MEM        : ORIGIN = L0_BASE, LENGTH = NCRISC_L0_LENGTH


    /* L1 layout */
    BRISC_CODE              : ORIGIN = L1_BASE, LENGTH = 32K
    BRISC_LOCAL_DATA_MEM    : ORIGIN = ORIGIN(BRISC_CODE) + LENGTH(BRISC_CODE), LENGTH = 32K
    BRISC_GCOV_MEM          : ORIGIN = ORIGIN(BRISC_LOCAL_DATA_MEM) + LENGTH(BRISC_LOCAL_DATA_MEM), LENGTH = 8K

    TRISC0_CODE             : ORIGIN = ORIGIN(BRISC_GCOV_MEM) + LENGTH(BRISC_GCOV_MEM), LENGTH = 64K
    TRISC0_LOCAL_DATA_MEM   : ORIGIN = ORIGIN(TRISC0_CODE) + LENGTH(TRISC0_CODE), LENGTH = 32K
    TRISC0_RUNTIME_ARGS      : ORIGIN = ORIGIN(TRISC0_LOCAL_DATA_MEM) + LENGTH(TRISC0_LOCAL_DATA_MEM), LENGTH = 1K
    TRISC0_GCOV_MEM         : ORIGIN = ORIGIN(TRISC0_RUNTIME_ARGS) + LENGTH(TRISC0_RUNTIME_ARGS), LENGTH = 8K

    TRISC1_CODE             : ORIGIN = ORIGIN(TRISC0_GCOV_MEM) + LENGTH(TRISC0_GCOV_MEM), LENGTH = 64K
    TRISC1_LOCAL_DATA_MEM   : ORIGIN = ORIGIN(TRISC1_CODE) + LENGTH(TRISC1_CODE), LENGTH = 32K
    TRISC1_RUNTIME_ARGS      : ORIGIN = ORIGIN(TRISC1_LOCAL_DATA_MEM) + LENGTH(TRISC1_LOCAL_DATA_MEM), LENGTH = 1K
    TRISC1_GCOV_MEM         : ORIGIN = ORIGIN(TRISC1_RUNTIME_ARGS) + LENGTH(TRISC1_RUNTIME_ARGS), LENGTH = 8K

    TRISC2_CODE             : ORIGIN = ORIGIN(TRISC1_GCOV_MEM) + LENGTH(TRISC1_GCOV_MEM), LENGTH = 64K
    TRISC2_LOCAL_DATA_MEM   : ORIGIN = ORIGIN(TRISC2_CODE) + LENGTH(TRISC2_CODE), LENGTH = 32K
    TRISC2_RUNTIME_ARGS      : ORIGIN = ORIGIN(TRISC2_LOCAL_DATA_MEM) + LENGTH(TRISC2_LOCAL_DATA_MEM), LENGTH = 1K
    TRISC2_GCOV_MEM         : ORIGIN = ORIGIN(TRISC2_RUNTIME_ARGS) + LENGTH(TRISC2_RUNTIME_ARGS), LENGTH = 8K

    RUNTIME_ARGS            : ORIGIN = RUNTIME_ARGS_START, LENGTH = 1K

    /* (discarded) */
    BRISC_LOADER_INIT_MEM   : ORIGIN = UNDEFINED, LENGTH = UNDEFINED
    BRISC_LOADER_CODE_MEM   : ORIGIN = UNDEFINED, LENGTH = UNDEFINED
    TRISC0_LOADER_INIT_MEM  : ORIGIN = UNDEFINED, LENGTH = UNDEFINED
    TRISC0_LOADER_CODE_MEM  : ORIGIN = UNDEFINED, LENGTH = UNDEFINED
    TRISC1_LOADER_INIT_MEM  : ORIGIN = UNDEFINED, LENGTH = UNDEFINED
    TRISC1_LOADER_CODE_MEM  : ORIGIN = UNDEFINED, LENGTH = UNDEFINED
    TRISC2_LOADER_INIT_MEM  : ORIGIN = UNDEFINED, LENGTH = UNDEFINED
    TRISC2_LOADER_CODE_MEM  : ORIGIN = UNDEFINED, LENGTH = UNDEFINED
    NCRISC_LOADER_INIT_MEM  : ORIGIN = UNDEFINED, LENGTH = UNDEFINED
    NCRISC_LOADER_CODE_MEM  : ORIGIN = UNDEFINED, LENGTH = UNDEFINED
}
PROVIDE(__instrn_buffer = 0xFFE40000);
