INCLUDE "tensix-memory.ld"

REGION_ALIAS("REGION_CODE", NOCRISC_CODE)
REGION_ALIAS("REGION_L1_CODE", NOCRISC_L1_CODE)
REGION_ALIAS("REGION_DATA", LOCAL_DATA_MEM_NOCRISC)
REGION_ALIAS("REGION_L1_DATA", NOCRISC_L1_SCRATCH)
REGION_ALIAS("REGION_RODATA", LOCAL_DATA_MEM_NOCRISC)
REGION_ALIAS("REGION_LDM", LOCAL_DATA_MEM_NOCRISC)

__firmware_start = ORIGIN(NOCRISC_CODE);
__firmware_stack_size = 1024;
__local_mem_rodata_start_addr = ORIGIN(LOCAL_DATA_MEM_NOCRISC); 

INCLUDE "ncrisc-sections.ld"
INCLUDE "tensix-address.ld"

