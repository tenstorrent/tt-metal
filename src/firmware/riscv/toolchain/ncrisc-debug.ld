INCLUDE "tensix-memory.ld"

REGION_ALIAS("REGION_CODE", NOCRISC_L1_CODE)
REGION_ALIAS("REGION_L1_CODE", NOCRISC_L1_CODE)
REGION_ALIAS("REGION_DATA", NOCRISC_L1_CODE)
REGION_ALIAS("REGION_L1_DATA", NOCRISC_L1_CODE)
REGION_ALIAS("REGION_RODATA", NOCRISC_L1_CODE)
REGION_ALIAS("REGION_LDM", NOCRISC_L1_CODE)

__firmware_start = ORIGIN(NOCRISC_L1_CODE);
__firmware_stack_size = 1024;

INCLUDE "ncrisc-sections.ld"
INCLUDE "tensix-address.ld"

