INCLUDE "tensix-memory.ld"

REGION_ALIAS("REGION_CODE", BRISC_CODE)
REGION_ALIAS("REGION_DATA", BRISC_CODE)
REGION_ALIAS("REGION_RODATA", BRISC_CODE)
REGION_ALIAS("REGION_LDM", BRISC_CODE)
REGION_ALIAS("REGION_ZEROS", ZEROS)

__firmware_stack_size = 1024;
__local_mem_rodata_start_addr = ORIGIN(BRISC_CODE);

INCLUDE "brisc-sections.ld"
