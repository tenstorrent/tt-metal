/* SPDX-FileCopyrightText: (c) 2026 Tenstorrent AI ULC
 * SPDX-License-Identifier: Apache-2.0
 */

/* Instrumented code and data live in L1; private memory holds only stacks. */
RUNTIME_ARGS_START = 0x8E000;
MEMORY
{
    TRISC0_STACK_MEM : ORIGIN = 0x802000, LENGTH = 4K
    TRISC1_STACK_MEM : ORIGIN = 0x804000, LENGTH = 2K
    TRISC2_STACK_MEM : ORIGIN = 0x806000, LENGTH = 2K
    TRISC3_STACK_MEM : ORIGIN = 0x808000, LENGTH = 4K

    TRISC0_CODE           : ORIGIN = 0x00000, LENGTH = 64K
    TRISC0_LOCAL_DATA_MEM : ORIGIN = 0x10000, LENGTH = 32K
    TRISC0_GCOV_MEM       : ORIGIN = 0x18000, LENGTH = 32K
    TRISC1_CODE           : ORIGIN = 0x20000, LENGTH = 64K
    TRISC1_LOCAL_DATA_MEM : ORIGIN = 0x30000, LENGTH = 32K
    TRISC1_GCOV_MEM       : ORIGIN = 0x38000, LENGTH = 32K
    TRISC2_CODE           : ORIGIN = 0x40000, LENGTH = 64K
    TRISC2_LOCAL_DATA_MEM : ORIGIN = 0x50000, LENGTH = 32K
    TRISC2_GCOV_MEM       : ORIGIN = 0x58000, LENGTH = 32K
    TRISC3_CODE           : ORIGIN = 0x60000, LENGTH = 64K
    TRISC3_LOCAL_DATA_MEM : ORIGIN = 0x70000, LENGTH = 32K
    TRISC3_GCOV_MEM       : ORIGIN = 0x78000, LENGTH = 32K
    RUNTIME_ARGS         : ORIGIN = RUNTIME_ARGS_START, LENGTH = 1K

    TRISC0_LOADER_INIT_MEM : ORIGIN = 0, LENGTH = 0
    TRISC1_LOADER_INIT_MEM : ORIGIN = 0, LENGTH = 0
    TRISC2_LOADER_INIT_MEM : ORIGIN = 0, LENGTH = 0
    TRISC3_LOADER_INIT_MEM : ORIGIN = 0, LENGTH = 0
    TRISC0_LOADER_CODE_MEM : ORIGIN = 0, LENGTH = 0
    TRISC1_LOADER_CODE_MEM : ORIGIN = 0, LENGTH = 0
    TRISC2_LOADER_CODE_MEM : ORIGIN = 0, LENGTH = 0
    TRISC3_LOADER_CODE_MEM : ORIGIN = 0, LENGTH = 0
}
PROVIDE(__instrn_buffer = 0x0080E000);
ASSERT(ORIGIN(TRISC3_GCOV_MEM) + LENGTH(TRISC3_GCOV_MEM) <= 0x8DFB8, "Coverage overlaps mailboxes")
